## Kconfig
```kconfig
mainmenu "Bootloader configuration"

menu "Chip"
	source "chip/Kconfig"
endmenu

menu "Core"
	source "core/Kconfig"
endmenu

menu "Device Drivers"
	source "drivers/Kconfig"
endmenu

source "common/Kconfig"


menuconfig MANUFACTURING
	bool "Manufacturing support"

if MANUFACTURING
	config FACTORY_BOOT
		bool "Factory boot support"
endif

menuconfig DEBUG
	bool "Debug options"

if DEBUG
	menuconfig PANIC
		bool "Panic support"

	if PANIC
	config PANIC_DUMP
		bool "Store panic on embedded flash"
		help
			Search if panic trace is present on ram and dump it into flash
	endif

	comment "Debug options disabled"
		depends on !PANIC

	config SYSTEM_EVENTS
		bool "System events"

	config PROFILING
		bool "profiling support"

	config PRINTK
		bool "printk support"
		depends on SERIAL

	config BOOT_SSBL_DISABLED
		bool "Disable jump in second stage"
		default n

	config DEBUG_RAMDUMP_SERIAL
		bool "ramdump support"
		depends on SERIAL

	menuconfig USB_DEBUG
		bool "Debug USB"

		if USB_DEBUG
		config USB_DEBUG_EP0
			bool "Debug USB endpoint 0"
		endif
endif

comment "Debug options disabled"
	depends on !DEBUG

menuconfig SECURITY
	bool "Security options"

if SECURITY
	config SECURE_BOOT_SSBL
			bool "SSBL secure boot"
			help
				FSBL verifies SSBL image signature before booting
			default n

	config SECURE_BOOT
			bool "Application secure boot"
			help
				SSBL verifies OS image signature before booting

	config SECURE_UPDATE
		bool "Secure update"
		help
			SSBL verifies OTA package signature before updating
endif

comment "Security options disabled"
	depends on !SECURITY

menuconfig CRYPTO
	bool "Cryptographic support"

if CRYPTO
	config SHARE_CRYPTO
		bool "Share crypto capabilities"

	config CRYPTO_SHA256
		bool "SHA256 digest algorithm"

	config CRYPTO_ECDSA
		bool "ECC digital signature algorithm"
endif

comment "Cryptographic support disabled"
	depends on !CRYPTO

menuconfig LIBRARY_ROUTINES
	bool "Library routines"

if LIBRARY_ROUTINES
	config COMP_LZG
		bool "LZG decompression support"
		depends on OTA
		help
			OTA package can be compressed to optimize transfer time

	config CRC16_CCITT
		depends on XMODEM
		default y
		bool "CRC16 CCITT support"
		help
			CRC16 CCITT algorithm

	config CRC32
		depends on OTA
		default y
		bool "CRC32 support"
		help
			CRC32 algorithm

endif

comment "Library routines support disabled"
	depends on !LIBRARY_ROUTINES

config SIGNATURE_HEADER_SIZE
	hex "Signature header size"
	default 0x80
```

## chip/Kconfig
```kconfig
config CHIP_VENDOR
	string "Chip/SoC vendor"

config CHIP_NAME
	string "Chip/SoC name"

source chip/intel/Kconfig
```

## chip/intel/Kconfig
```kconfig
menuconfig CLOCK
	bool "Clock setup"

	if CLOCK
		config CLOCK_SPEED
		int "Clock speed"
		default 0
	endif

menuconfig OSCILLATOR
	bool "Oscillator setup"

	if OSCILLATOR
		choice
			prompt "Source"
			default INTERNAL_OSCILLATOR

		config INTERNAL_OSCILLATOR
			bool "Internal"

		config EXTERNAL_OSCILLATOR
			bool "External"
		endchoice

		choice
			prompt "Define value"
			default FACTORY_OSCILLATOR_TRIM_VALUE
			depends on INTERNAL_OSCILLATOR

		config FACTORY_OSCILLATOR_TRIM_VALUE
			bool "Factory"
			depends on INTERNAL_OSCILLATOR

		config CUSTOM_OSCILLATOR_TRIM_VALUE
			hex "Custom"
			depends on INTERNAL_OSCILLATOR
		endchoice
	endif

-source "chip/intel/*/Kconfig"
```

## chip/intel/quark_se/Kconfig
```kconfig
if CHIP_NAME = "quark_se"
	 menu "Advanced setup"
	     config SENSOR_CORE_HELPER
		 bool "Enable sensor core helper"
		 depends on HARDWARE_CHARGING
		 help
		     Use minimal binary on sensor core to access ADC block
		     ADC block is only accessible from sensor core on Quark SE
	 endmenu
endif
```

## common/Kconfig
```kconfig
menu "General setup"
	menu "Binary setup"

		menuconfig CUSTOM_LINKER_SCRIPT
			bool "Custom linker script"
			if CUSTOM_LINKER_SCRIPT
				config LINKER_SCRIPT
					string "Linker script"
					default "$(BOOTLOADER_ROOT)/board/"
			endif

		config BIN_FORMAT
			bool "Enable binary format"

		config XIP
			bool "Enable XIP"

		config LOAD_ADDRESS
			hex "Load address (flash/rom origin)"
			default 0x00000000

		config BINARY_LENGTH
			hex "Maximum binary length"
			default 0x00000000

		config RAM_START_ADDRESS
			hex "RAM start address"
			default 0x00000000

		config RAM_MAXIMUM_SIZE
			hex "RAM maximum size"
			default 0x00000000
	endmenu

	config BALLOC
		bool "balloc support"

	config USB_DFU_VID
		hex "Usb dfu VID"
		depends on USB_DFU
		default "0x8087"

	config USB_DFU_PID
		hex "Usb dfu PID"
		default "0x0a99"
		depends on USB_DFU

	config HARDWARE_CHARGING
		bool "Hardware charging"

	config BATT_THRESHOLD_MV
		int "Hardware charging threshold"
		default 3300
		depends on HARDWARE_CHARGING
		help
			Hardware charging threshold (mV)

	config DNX
		bool "DnX support"
		depends on USB_DFU || XMODEM

	config DNX_TIMEOUT_S
		int "USB DnX timeout"
		default 10
		depends on USB_DFU

	config XMODEM_PACKET_SIZE
			int "xmodem packet size"
			default 1024
			depends on XMODEM
			help
				Possible values are 1024, 128

	config QUIRKS_FEATURES
		bool "Enable quirks and features support"
			help
				Quirks and Features are a mechanism where bootloader uses boardid (or equivalent)
				to enable/disable quirks, features and workarounds that are board specific.

				Rational being to avoid spreading boardid switches in the code, as it is error-prone
				and becomes quickly unmaintainable.

endmenu

menuconfig OPTION_UPDATE
	bool "Firmware update options"

if OPTION_UPDATE
	config OTA
		bool "OTA support"
		default n

	config USB_DFU
		bool "DFU support"

	if USB_DFU
		menu "DFU alternates"
			config CACHE_PARTITION
				bool "cache"
				depends on SPI_FLASH
				help
					Spi Flash partition used to store ota package

			config LOG_PARTITION
				bool "log"
				depends on SPI_FLASH
				help
					Spi Flash partition used to store log. Partition overlaps cache partition

			config SPI_FLASH_APP_DATA_PARTITION
				bool "application data"
				depends on SPI_FLASH
				help
					Spi Flash partition used to store apps datas

			config SPI_FLASH_SYS_EVENT_PARTITION
				bool "system event"
				depends on SPI_FLASH
				help
					Spi Flash partition used to store systems events history

			config SPI_FLASH_USER_DATA_PARTITION
				bool "user data"
				depends on SPI_FLASH
				help
					Spi Flash partition used to store user datas

		endmenu
	endif
endif

comment "Update options disabled"
	depends on !OPTION_UPDATE

menuconfig BOOT_OPTION
	bool "Boot options"
	default y
if BOOT_OPTION

	config ADVANCED_BOOT
		bool "Advanced boot"

	config PLAY_BOOT_PATTERN
		bool "Enable boot notification"
endif

comment "Boot options disabled"
	depends on !BOOT_OPTION
```

## core/x86/Kconfig
```kconfig
config X86
	bool "x86"

source "core/x86/intel/Kconfig"
source "core/x86/quark/Kconfig"
```

## core/x86/intel/Kconfig
```kconfig
menu "Generic"
depends on X86

config BOOTSTRAP
bool "16bit boot mode"
depends on X86
endmenu
```

## drivers/Kconfig
```kconfig
source "drivers/watchdog/Kconfig"

menuconfig USB
	bool "USB support"
	source "drivers/usb/Kconfig"

menuconfig LED
	bool "LED support"
	source "drivers/led/Kconfig"

menuconfig MISC
	bool "Misc drivers"
	source "drivers/swd/Kconfig"

menuconfig MTD
	bool "MTD support"
	source "drivers/mtd/Kconfig"

menuconfig SERIAL
	bool "Serial support"
	select UART
	source "drivers/serial/Kconfig"

config D_FLIP_FLOP
	bool "Flip flop support"

if D_FLIP_FLOP
	config D_FF_D_PIN
		int "Flip flop input pin"
		depends on D_FLIP_FLOP
		default 14

	config D_FF_CK_PIN
		int "Flip flop clock pin"
		depends on D_FLIP_FLOP
		default 11
endif


#
# Menuconfig SPI
#
menuconfig SPI
	bool "SPI Support"
	help
		SPI support
if SPI
	config SPI_MASTER
		bool "Master support"

	config SPI_MASTER_INTERFACE
		int "Interface"
		default 0
		depends on SPI_MASTER

	comment "SPI master support disabled"
	depends on !SPI_MASTER
endif

comment "SPI support disabled"
	depends on !SPI

#
# Menuconfig I2C
#
menuconfig I2C
	bool "I2C support"
	help
		I2C support
if I2C
	config I2C_PORT_SELECT
		bool "I2C port selection"
	config I2C_PORT
		int "Interface"
		default 0
		depends on I2C_PORT_SELECT
	config I2C_READ
		bool "Read functions"
		default n
endif

comment "I2C support disabled"
depends on !I2C

#
# Menuconfig UART
#
config UART
	bool "UART support"
	help
		Uart driver used for xmodem or printk console

#
# Menuconfig GPIO
#
config GPIO
	bool "GPIO support"
	help
		GPIO support
```

## drivers/led/Kconfig
```kconfig
if LED
	menuconfig LP5562
		bool "LP5562 support"
		select I2C
		select SOC_LED

	config SOC_LED
		bool "SoC LED"

	config LP5562_I2C
		int "i2c port"
		default 1

	config LP5562_MINIMAL
		bool "Minimal support"
		depends on LP5562

	config LP5562_PATTERN
		bool "Pattern support"
		depends on LP5562
		select LP5562_MINIMAL

	config PLAY_BOOT_PATTERN
		bool "Notify boot"
		depends on LP5562_PATTERN

	comment "LP5562 support disabled"
		depends on !LP5562
endif

comment "LED support disabled"
	depends on !LED
```

## drivers/mtd/Kconfig
```kconfig
if MTD
	menuconfig SPI_FLASH
		bool "SNOR support (SPI Flash)"
		depends on SPI

	config SPI_FLASH_MX25
		bool "MX25 family"

	choice
		prompt "Spi flash vendor"
		default SPI_FLASH_MX25U12835F
		depends on SPI_FLASH
		help
			Select spi flash driver

		config SPI_FLASH_W25Q16DV
			bool "SPI NOR Flash Winbond W25Q16DV on Intel QRK"
			select SPI_FLASH_MX25

		config SPI_FLASH_MX25U12835F
			bool "SPI NOR Flash Macronix MX25U12835F on Intel QRK"
			select SPI_FLASH_MX25

		config SPI_FLASH_MX25R1635F
			bool "SPI NOR Flash Macronix MX25R1635F on Intel QRK"
			select SPI_FLASH_MX25

		config SPI_FLASH_MX25R6435F
			bool "SPI NOR Flash Macronix MX25R6435F on Intel QRK"
			select SPI_FLASH_MX25
	endchoice

	comment "SNOR support disabled"
		depends on !SPI_FLASH
endif

comment "MTD support disabled"
	depends on !MTD
```

## drivers/serial/Kconfig
```kconfig
if SERIAL
	config NS16550
		bool "NS16550 support"
		depends on SERIAL
		help
			Uart driver used for xmodem or printk console

	config XMODEM
		bool "xmodem support"
		depends on SERIAL
		help
			Enable xmodem protocol used for flashing bootloader

endif

comment "Serial support disabled"
	depends on !SERIAL
```

## drivers/swd/Kconfig
```kconfig
if MISC
	config SWD
		bool "SWD flashing driver"
		help
			Used to flash Bluetooth Nordic IC
endif

comment "MISC support disabled"
depends on !MISC
```

## drivers/usb/Kconfig
```kconfig
#
# USB device configuration

if USB
	menuconfig USB_DEVICE
		bool "Device support"

		config USB_DWC_3_10B
			bool "DWC 3.1B"
			depends on USB_DEVICE

	comment "Device support disabled"
		depends on !USB_DEVICE
endif

comment "USB support disabled"
	depends on !USB
```

## drivers/watchdog/Kconfig
```kconfig
menuconfig WATCHDOG
	bool "Watchdog support"

if WATCHDOG
	 config WATCHDOG_TIMEOUT
		 int "Timeout"
		 default 10
		 depends on WATCHDOG
endif

comment "Watchdog support disabled"
	depends on !WATCHDOG
```
